## components/mqtt_manager/Kconfig.projbuild
```kconfig
menu "MQTT Manager Configuration"

    config MQTT_HOST
        string "MQTT broker host"
        default "192.168.1.10"
        help
            Hostname or IP address of the MQTT broker to connect to.

    config MQTT_PORT
        int "MQTT broker port"
        default 1883
        help
            TCP port of the MQTT broker.

    config MQTT_USERNAME
        string "MQTT username"
        default "username"
        help
            Username for MQTT authentication. Leave empty if not required.

    config MQTT_PASSWORD
        string "MQTT password"
        default "password"
        help
            Password for MQTT authentication. Leave empty if not required.

endmenu
```

## components/sht31_driver/Kconfig.projbuild
```kconfig
menu "SHT31 driver"

    config SHT31_I2C_PORT
        int "I2C port number"
        range 0 1
        default 0
        help
            I2C port (controller) the SHT31 sensor is connected to.

    config SHT31_I2C_SDA_GPIO
        int "I2C SDA GPIO number"
        range 0 48
        default 21
        help
            GPIO number used for the I2C SDA line.

    config SHT31_I2C_SCL_GPIO
        int "I2C SCL GPIO number"
        range 0 48
        default 22
        help
            GPIO number used for the I2C SCL line.

    config SHT31_I2C_FREQ_HZ
        int "I2C clock frequency (Hz)"
        range 1000 1000000
        default 100000
        help
            SCL clock frequency in Hz. The SHT31 supports up to 1 MHz (fast mode plus).

    config SHT31_I2C_ADDR
        hex "I2C device address (7-bit)"
        range 0x44 0x45
        default 0x44
        help
            7-bit I2C address of the SHT31. 0x44 when the ADDR pin is tied low,
            0x45 when it is tied high.

    config SHT31_I2C_ENABLE_PULLUP
        bool "Enable internal pull-ups on SDA/SCL"
        default y
        help
            Enable the ESP32 internal pull-up resistors on the I2C lines.
            Disable this if you use external pull-up resistors.

endmenu
```

## components/wifi_manager/Kconfig.projbuild
```kconfig
menu "WiFi Manager Configuration"

    config WIFI_SSID
        string "WiFi SSID"
        default "myssid"
        help
            SSID (network name) for the device to connect to.

    config WIFI_PASSWORD
        string "WiFi Password"
        default "mypassword"
        help
            WiFi password (WPA or WPA2) for the device to use.
            Leave empty for an open network.

    config WIFI_MAXIMUM_RETRY
        int "Maximum connection retries"
        default 10
        help
            Number of times to retry connecting to the AP before giving up.

endmenu
```
